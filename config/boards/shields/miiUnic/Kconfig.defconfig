## config/boards/shields/miiUnic/Kconfig.defconfig
```kconfig
if SHIELD_MIIUNIC_LEFT

# Name must be less than 16 characters long!
config ZMK_KEYBOARD_NAME
    default "miiUnic"

config ZMK_SPLIT_ROLE_CENTRAL
    default y

endif

if SHIELD_MIIUNIC_LEFT || SHIELD_MIIUNIC_RIGHT

config ZMK_SPLIT
    default y

config ZMK_POINTING
    default y

endif

if SHIELD_MIIUNIC_LEFT

config SPI
    default y

endif

if SHIELD_MIIUNIC_RIGHT

config I2C
    default y

endif
```
